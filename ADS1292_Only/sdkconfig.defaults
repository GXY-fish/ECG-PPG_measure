## ADS1292_Only/sdkconfig.defaults
```kconfig
# 目标芯片：ESP32-S3-DevKitC-1
CONFIG_IDF_TARGET="esp32s3"

# 串口监视：UART0(GPIO43/44) 为主，原生 USB 为副
CONFIG_ESP_CONSOLE_UART_BAUDRATE=115200
CONFIG_ESP_CONSOLE_SECONDARY_USB_SERIAL_JTAG=y

CONFIG_ESP_MAIN_TASK_STACK_SIZE=4096
```

## ESP32-S3_IDF/sdkconfig.defaults
```kconfig
# 目标芯片：ESP32-S3-DevKitC-1
CONFIG_IDF_TARGET="esp32s3"

# 串口监视器默认波特率（UART0, GPIO43/44）
CONFIG_ESP_CONSOLE_UART_BAUDRATE=115200

# 主任务栈稍加大（算法局部变量较多）
CONFIG_ESP_MAIN_TASK_STACK_SIZE=4096
```
